## Kconfig
```kconfig
#
# Copyright 2014, Wink Saville
#
# This software may be distributed and modified according to the terms of
# the BSD 2-Clause license. Note that NO WARRANTY is provided.
# See "LICENSE_BSD2.txt" for details.

# This file defines the Kconfig menu structure.

mainmenu "Project Configuration"

config COMMON_PATH
    string
    option env="COMMON_PATH"

menu "seL4 Applications"
    source "apps/test-newlibs/Kconfig"
    source "apps/min-app/Kconfig"
    source "apps/hw/Kconfig"
    source "apps/helloworld/Kconfig"
    source "apps/assert/Kconfig"
    source "apps/myassert/Kconfig"
    source "apps/bootinfo/Kconfig"
endmenu

menu "seL4 Kernel"
    source "kernel/Kconfig"
endmenu

menu "seL4 Libraries"
    source "libs/libsel4/Kconfig"
    source "libs/libsel4_putchar/Kconfig"
    source "libs/libsel4_printf/Kconfig"
    source "libs/libsel4_assert/Kconfig"
    source "libs/libsel4_benchmark/Kconfig"
endmenu

source "$COMMON_PATH/Kconfig"
```

## apps/min-hw/Kconfig
```kconfig
#
# Copyright 2015, Wink Saville
#
# This software may be distributed and modified according to the terms of
# the BSD 2-Clause license. Note that NO WARRANTY is provided.
# See "LICENSE_BSD2.txt" for details.

menuconfig APP_MIN_HW
    bool "min-hw"
    default n
    select LIB_SEL4
    select LIB_SEL4_GEN
    select LIB_SEL4_STARTUP
    select LIB_SEL4_HALT
    select LIB_SEL4_BOOTINFO
    select LIB_SEL4_PUTCHAR
    help
        Minimal Hello World application
```

## apps/test-newlibs/Kconfig
```kconfig
#
# Copyright 2015, Wink Saville
#
# This software may be distributed and modified according to the terms of
# the BSD 2-Clause license. Note that NO WARRANTY is provided.
# See "LICENSE_BSD2.txt" for details.

menuconfig APP_TEST_NEWLIBS
    bool "test-newlibs"
    default n
    select LIB_SEL4_GEN 
    select LIB_SEL4_STARTUP 
    select LIB_SEL4_BOOTINFO 
    select LIB_SEL4_HALT 
    select LIB_SEL4_BENCHMARK 
    select LIB_SEL4_PUTCHAR 
    select LIB_SEL4_ASSERT 
    select LIB_SEL4_PRINTF 
    select LIB_SEL4
    help
        Test new libs
```

## kernel/libsel4/Kconfig
```kconfig
#
# Copyright 2014, NICTA
#
# This software may be distributed and modified according to the terms of
# the BSD 2-Clause license. Note that NO WARRANTY is provided.
# See "LICENSE_BSD2.txt" for details.
#
# @TAG(NICTA_BSD)
#

menuconfig LIB_SEL4
    bool "Build sel4 library"
    default n
    select LIB_SEL4_GEN
    help
        "Build the sel4 library"
```

## libs/libsel4_assert/Kconfig
```kconfig
#
# Copyright 2015, Wink Saville
#
# This software may be distributed and modified according to the terms of
# the BSD 2-Clause license. Note that NO WARRANTY is provided.
# See "LICENSE_BSD2.txt" for details.
#

menuconfig LIB_SEL4_ASSERT
    bool "Build sel4 assert library"
    default n
    select LIB_SEL4
    select LIB_SEL4_PRINTF
    help
        "Implements libsel4_fail, libsel4_assert and libsel4_compile_assert"
```

## libs/libsel4_benchmark/Kconfig
```kconfig
#
# Copyright 2015, Wink Saville
#
# This software may be distributed and modified according to the terms of
# the BSD 2-Clause license. Note that NO WARRANTY is provided.
# See "LICENSE_BSD2.txt" for details.
#

menuconfig LIB_SEL4_BENCHMARK
    bool "Build sel4 benchmark library"
    default n
    select BENCHMARK
    select LIB_SEL4
    help
        Implements the benchmark.
```

## libs/libsel4_bootinfo/Kconfig
```kconfig
#
# Copyright 2015, Wink Saville
#
# This software may be distributed and modified according to the terms of
# the BSD 2-Clause license. Note that NO WARRANTY is provided.
# See "LICENSE_BSD2.txt" for details.
#

menuconfig LIB_SEL4_BOOTINFO
    bool "Build sel4 bootinfo library"
    default n
    select LIB_SEL4
    help
        Implements seL4_GetBootInfo and seL4_InitBootInfo.
```

## libs/libsel4_halt/Kconfig
```kconfig
#
# Copyright 2015, Wink Saville
#
# This software may be distributed and modified according to the terms of
# the BSD 2-Clause license. Note that NO WARRANTY is provided.
# See "LICENSE_BSD2.txt" for details.
#

menuconfig LIB_SEL4_HALT
    bool "Build sel4 halt library"
    default n
    select LIB_SEL4_GEN
    help
        Implements seL4_Halt() used by seL4_Assert and seL4_Fail when an assert fails.
```

## libs/libsel4_putchar/Kconfig
```kconfig
#
# Copyright 2015, Wink Saville
#
# This software may be distributed and modified according to the terms of
# the BSD 2-Clause license. Note that NO WARRANTY is provided.
# See "LICENSE_BSD2.txt" for details.
#

menuconfig LIB_SEL4_PUTCHAR
    bool "Build sel4 putchar library"
    default n
    help
        "Build the library which defines libsel4_putchar(char)"
```

## libs/libsel4_startup/Kconfig
```kconfig
#
# Copyright 2015, Wink Saville
#
# This software may be distributed and modified according to the terms of
# the BSD 2-Clause license. Note that NO WARRANTY is provided.
# See "LICENSE_BSD2.txt" for details.
#

menuconfig LIB_SEL4_STARTUP
    bool "Build sel4 startup library"
    default n
    help
        Implements the startup code initializes the runtime and invokes int main(void).
```
